## config/west.yml
```yaml
manifest:
  remotes:
    - name: zmkfirmware
      url-base: https://github.com/zmkfirmware
    - name: Aleblazer
      url-base: https://github.com/Aleblazer
  projects:
    - name: zmk
      remote: Aleblazer
      revision: Zodiark
      import: app/west.yml
  self:
    path: config
```
